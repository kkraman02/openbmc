## meta-ampere/meta-adlink/conf/machine/comhpcalt.conf
```bitbake
KMACHINE = "aspeed"
KERNEL_DEVICETREE = "aspeed/${KMACHINE}-bmc-adlink-${MACHINE}.dtb"

PREFERRED_PROVIDER_virtual/bootloader = "u-boot-aspeed"
PREFERRED_PROVIDER_u-boot = "u-boot-aspeed"
PREFERRED_PROVIDER_u-boot-fw-utils = "u-boot-fw-utils-aspeed"
UBOOT_MACHINE = "ast_g5_phy_config"

require conf/machine/include/ast2500.inc
require conf/machine/include/obmc-bsp-common.inc
require conf/distro/include/phosphor-aspeed-spi-master-mode.inc

# Reformat SPI flash layout to 32MB
FLASH_UBOOT_OFFSET  = "0"
FLASH_KERNEL_OFFSET = "1024"
FLASH_ROFS_OFFSET   = "5312"
FLASH_RWFS_OFFSET   = "30912"

# Reformat SPI flash layout to 64MB
FLASH_UBOOT_OFFSET:flash-65536  = "0"
FLASH_KERNEL_OFFSET:flash-65536 = "1024"
FLASH_ROFS_OFFSET:flash-65536   = "10240"
FLASH_RWFS_OFFSET:flash-65536   = "43008"

# Reformat SPI flash layout to 128MB
FLASH_UBOOT_OFFSET:flash-131072  = "0"
FLASH_KERNEL_OFFSET:flash-131072 = "1024"
FLASH_ROFS_OFFSET:flash-131072   = "10240"
FLASH_RWFS_OFFSET:flash-131072   = "98304"

MACHINE_FEATURES += "\
        obmc-phosphor-chassis-mgmt \
        obmc-phosphor-flash-mgmt \
        obmc-phosphor-fan-mgmt \
        obmc-chassis-state-mgmt \
        obmc-host-state-mgmt \
        obmc-bmc-state-mgmt \
        obmc-host-ipmi \
        "

VOLATILE_LOG_DIR = "no"

OBMC_IMAGE_EXTRA_INSTALL:append = "\
                                   ampere-utils \
                                   ampere-usbnet \
                                   ampere-misc \
                                   adlink-mac-update \
                                   ampere-platform-init \
                                   virtual-media \
                                   x86-power-control \
                                   ampere-ipmi-oem \
                                  "

OBMC_IMAGE_EXTRA_INSTALL:append:flash-65536:flash-131072 = "\
                                   lmsensors \
                                   phosphor-ipmi-blobs \
                                   phosphor-ipmi-blobs-binarystore \
                                   logger-systemd \
                                  "

PREFERRED_PROVIDER_virtual/obmc-chassis-mgmt = "packagegroup-ampere-apps"
PREFERRED_PROVIDER_virtual/obmc-system-mgmt = "packagegroup-ampere-apps"
PREFERRED_PROVIDER_virtual/obmc-host-ipmi-hw = "phosphor-ipmi-ssif"
PREFERRED_PROVIDER_virtual/obmc-flash-mgmt = "packagegroup-ampere-apps"
PREFERRED_PROVIDER_virtual/phosphor-ipmi-fru-hostfw-config ?= "hostboot-inventory-config-native"
PREFERRED_PROVIDER_virtual/phosphor-led-manager-config-native = "comhpcalt-led-manager-config-native"

VIRTUAL-RUNTIME_obmc-host-state-manager = "x86-power-control"
VIRTUAL-RUNTIME_obmc-chassis-state-manager = "x86-power-control"

VIRTUAL-RUNTIME_obmc-inventory-manager = "entity-manager"
VIRTUAL-RUNTIME_obmc-sensors-hwmon = "dbus-sensors"

OVERRIDES .= "${@":ampere" if FLASH_SIZE == '32768' else ":ampere:flash-65536" if FLASH_SIZE == '65536' else ":ampere:flash-131072"}"
```

## meta-ampere/meta-mitchell/conf/machine/mtmitchell-dcscm.conf
```bitbake
require conf/machine/mtmitchell.conf
KERNEL_DEVICETREE = "aspeed/${KMACHINE}-bmc-ampere-mtmitchell.dtb"
```
